VERSION ""

NS_ :

BS_:

BU_: TestECU

BO_ 256 TestMessage: 8 TestECU
 SG_ TestSignal : 0|16@1+ (0.1,0) [0|100] "degC" TestECU
 SG_ TestSignal2 : 16|16@1+ (1.0,0) [0|1000] "rpm" TestECU
